/*
 * Copyright (C) 2017-2017 Embest - http://www.embest-tech.com/
 *
 * This program is free software; you can redistribute it and/or modify
 * it under the terms of the GNU General Public License version 2 as
 * published by the Free Software Foundation.
 */
 
#include "embest-SOM_AM572x_TM-common.dtsi"

&aliases {
	display0 = &lcd0;
        display1 = &hdmi0;
        sound0 = &sound0;
        sound1 = &hdmi;
};
